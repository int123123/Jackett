## esp32-ld2450-cam/main/Kconfig.projbuild
```kconfig
menu "Application Configuration"

config WIFI_SSID
    string "WiFi SSID"
    default "YOUR_SSID"

config WIFI_PASSWORD
    string "WiFi password"
    default "YOUR_PASSWORD"

config MQTT_BROKER_URI
    string "MQTT broker URI"
    default "mqtt://192.168.1.10"

config MQTT_BASE_TOPIC
    string "MQTT base topic"
    default "sensors"

config MQTT_USERNAME
    string "MQTT username"
    default ""

config MQTT_PASSWORD
    string "MQTT password"
    default ""

config DELAY_AFTER_NO_PERSON_MS
    int "Delay after person lost (ms)"
    default 2000
    range 0 60000

config MIN_CAMERA_HOLD_MS
    int "Minimal camera hold after radar trigger (ms)"
    default 1500
    range 0 60000

config PERSON_CONFIRM_FRAMES
    int "Frames to confirm person"
    default 2
    range 1 30

config PERSON_LOST_FRAMES
    int "Frames before person considered lost"
    default 3
    range 1 60

menu "Camera"

config CAMERA_WARMUP_MS
    int "Warmup frames delay (ms)"
    default 500
    range 0 5000

config PERSON_MIN_SKIN_RATIO_PERCENT
    int "Min skin ratio percent for presence"
    default 1
    range 0 30

config CAMERA_FRAMESIZE_QQVGA
    bool "Use QQVGA (160x120) instead of QVGA"
    default y

config CAMERA_CUSTOM_PINS
    bool "Custom camera pins (override AI-Thinker)"
    default n

endmenu

menu "LD2450 Radar"

choice LD2450_METHOD
    prompt "LD2450 method"
    default LD2450_METHOD_UART
    help
        Choose how to read presence from LD2450

config LD2450_METHOD_GPIO
    bool "GPIO digital input"

config LD2450_METHOD_UART
    bool "UART frames"

endchoice

config LD2450_POWER_GPIO
    int "Radar power control GPIO (-1 to disable)"
    default -1
    range -1 39

if LD2450_METHOD_GPIO
config LD2450_PRESENCE_GPIO
    int "Presence input GPIO"
    default 33
    range 0 39
config LD2450_PRESENCE_ACTIVE_HIGH
    bool "Presence active-high"
    default y
endif

if LD2450_METHOD_UART
config LD2450_UART_NUM
    int "UART number (0..2)"
    default 2
    range 0 2
config LD2450_UART_TX
    int "UART TX GPIO"
    default 14
    range -1 39
config LD2450_UART_RX
    int "UART RX GPIO"
    default 15
    range -1 39
config LD2450_UART_BAUD
    int "UART baud rate"
    default 115200
    range 9600 460800
endif

endmenu

endmenu
```

## esp32-ld2450-cam/sdkconfig.defaults
```kconfig
# Target
CONFIG_IDF_TARGET="esp32"

# WiFi (these map to project Kconfig)
CONFIG_WIFI_SSID="YOUR_SSID"
CONFIG_WIFI_PASSWORD="YOUR_PASSWORD"

# PSRAM
CONFIG_ESP32_SPIRAM_SUPPORT=y
CONFIG_SPIRAM_SUPPORT=y
CONFIG_ESP32_SPIRAM_BOOT_INIT=y
CONFIG_ESP32_DEFAULT_PSRAM_CLK_IO=17
CONFIG_ESP32_DEFAULT_PSRAM_CS_IO=16

# MQTT
CONFIG_MQTT_PROTOCOL_311=y

# Logging
CONFIG_LOG_COLORS=y
CONFIG_LOG_DEFAULT_LEVEL_INFO=y

# Camera
CONFIG_CAMERA_WARMUP_MS=500
CONFIG_PERSON_MIN_SKIN_RATIO_PERCENT=1
CONFIG_CAMERA_FRAMESIZE_QQVGA=y

# Controller
CONFIG_DELAY_AFTER_NO_PERSON_MS=2000
CONFIG_MIN_CAMERA_HOLD_MS=1500
CONFIG_PERSON_CONFIRM_FRAMES=2
CONFIG_PERSON_LOST_FRAMES=3

# LD2450
CONFIG_LD2450_METHOD_UART=y
CONFIG_LD2450_UART_NUM=2
CONFIG_LD2450_UART_TX=14
CONFIG_LD2450_UART_RX=15
CONFIG_LD2450_UART_BAUD=115200
CONFIG_LD2450_POWER_GPIO=-1
```

## esp32c3-virtual-pult/sdkconfig.defaults
```kconfig
# Target
CONFIG_IDF_TARGET="esp32c3"

# Use NimBLE (recommended for ESP32-C3)
CONFIG_BT_ENABLED=y
CONFIG_BT_NIMBLE_ENABLED=y
CONFIG_BT_BLUEDROID_ENABLED=n
CONFIG_BT_CONTROLLER_ENABLED=y
CONFIG_BT_BLE_ENABLED=y
CONFIG_BT_CLASSIC_ENABLED=n
CONFIG_NIMBLE_ENABLED=y
CONFIG_NIMBLE_STACK_USE_MEM_POOLS=y
CONFIG_BTDM_CTRL_MODE_BLE_ONLY=y

# Reduce logging
CONFIG_LOG_DEFAULT_LEVEL_INFO=y

# GPIO pullups are handled in code
```

## esp_person_counter/main/Kconfig.projbuild
```kconfig
menu "ESP Person Counter"

config PERSON_COUNTER_FRAME_SIZE
    string "Camera frame size"
    default "QVGA"
    help
        Camera frame size used for capture and preprocessing.
        Options: QQVGA, QVGA, VGA, SVGA, XGA, SXGA, UXGA

config PERSON_COUNTER_YOLO_INPUT_SIZE
    int "YOLO input size (square)"
    range 128 416
    default 320

config PERSON_COUNTER_SCORE_THRESHOLD
    int "Detection score threshold (percent)"
    range 1 99
    default 40

config PERSON_COUNTER_NMS_IOU
    int "NMS IoU threshold (percent)"
    range 10 90
    default 50

menu "Camera Pins"

config CAM_PIN_PWDN
    int "PWDN GPIO"
    default -1
config CAM_PIN_RESET
    int "RESET GPIO"
    default -1
config CAM_PIN_XCLK
    int "XCLK GPIO"
    default 10
config CAM_PIN_SIOD
    int "SIOD GPIO (SDA)"
    default 4
config CAM_PIN_SIOC
    int "SIOC GPIO (SCL)"
    default 5
config CAM_PIN_D7
    int "D7 GPIO"
    default 16
config CAM_PIN_D6
    int "D6 GPIO"
    default 15
config CAM_PIN_D5
    int "D5 GPIO"
    default 7
config CAM_PIN_D4
    int "D4 GPIO"
    default 6
config CAM_PIN_D3
    int "D3 GPIO"
    default 13
config CAM_PIN_D2
    int "D2 GPIO"
    default 12
config CAM_PIN_D1
    int "D1 GPIO"
    default 11
config CAM_PIN_D0
    int "D0 GPIO"
    default 9
config CAM_PIN_VSYNC
    int "VSYNC GPIO"
    default 8
config CAM_PIN_HREF
    int "HREF GPIO"
    default 18
config CAM_PIN_PCLK
    int "PCLK GPIO"
    default 17

endmenu

endmenu
```

## esp_person_counter/sdkconfig.defaults
```kconfig
CONFIG_ESP_MAIN_TASK_STACK_SIZE=12288
CONFIG_ESP_SYSTEM_PANIC_PRINT_REBOOT=y
CONFIG_SPIRAM_MODE_QUAD=y
CONFIG_SPIRAM=y
CONFIG_SPIRAM_BOOT_INIT=y
CONFIG_ESP32S3_SPIRAM_SUPPORT=y
CONFIG_SPIRAM_USE_MALLOC=y
CONFIG_SPIRAM_MALLOC_ALWAYSINTERNAL=32768
CONFIG_ESP_HEAP_POISONING_DISABLED=y
CONFIG_LOG_DEFAULT_LEVEL_INFO=y
CONFIG_CAMERA_CORE0=y
CONFIG_TASK_WDT_TIMEOUT_S=30
CONFIG_COMPILER_CXX_EXCEPTIONS=y
CONFIG_COMPILER_CXX_RTTI=y
```

## main/Kconfig
```kconfig
menu "LD2450 CAM MQTT App"

config APP_WIFI_SSID
    string "WiFi SSID"
    default "YOUR_SSID"
    help
        WiFi SSID for station mode.

config APP_WIFI_PASSWORD
    string "WiFi Password"
    default "YOUR_PASSWORD"
    help
        WiFi password for station mode.

config APP_MQTT_URI
    string "MQTT broker URI"
    default "mqtt://192.168.1.100:1883"
    help
        Example: mqtt://host:1883 or mqtts://host:8883

config APP_MQTT_USERNAME
    string "MQTT username"
    default ""

config APP_MQTT_PASSWORD
    string "MQTT password"
    default ""

config APP_LD2450_UART_PORT
    int "LD2450 UART port (0-2)"
    range 0 2
    default 2

config APP_LD2450_BAUD
    int "LD2450 baud rate"
    default 256000

config APP_LD2450_PIN_TX
    int "LD2450 UART TX GPIO"
    default 13

config APP_LD2450_PIN_RX
    int "LD2450 UART RX GPIO"
    default 14

config APP_RADAR_POWER_GPIO
    int "GPIO to control radar power (optional)"
    default -1
    help
        Use -1 if not wired. If >=0, HIGH turns radar on by default (depends on wiring).

config APP_CAMERA_PIXEL_FORMAT
    int "Camera pixel format (0=JPEG,1=RGB565)"
    range 0 1
    default 0

config APP_CAMERA_FRAME_SIZE
    int "Camera frame size (0=QVGA,1=VGA,2=SVGA,3=XGA,4=SXGA,5=UXGA)"
    range 0 5
    default 1

config APP_PERSON_LOSS_TIMEOUT_MS
    int "Delay before turning camera off after no person"
    default 3000

config APP_LD2450_MOTION_HOLD_MS
    int "Hold radar motion 'true' this many ms after last packet"
    default 500

config APP_USE_TFLM
    bool "Use TensorFlow Lite Micro person detection"
    default n
    help
        When enabled, camera person detection should use TFLM model.
        You must add a TFLM model and dependency manually.

config APP_TFLM_SCORE_THRESHOLD
    int "TFLM person score threshold (0-255)"
    range 0 255
    default 180
    depends on APP_USE_TFLM

endmenu
```

## sdkconfig.defaults
```kconfig
# Flashing/Part
CONFIG_ESPTOOLPY_FLASHSIZE_4MB=y
CONFIG_PARTITION_TABLE_CUSTOM=y
CONFIG_PARTITION_TABLE_FILENAME="partitions.csv"
CONFIG_ESP32_SPIRAM_SUPPORT=y
CONFIG_SPIRAM=y
CONFIG_ESP32_DEFAULT_CPU_FREQ_240=y

# Logging
CONFIG_LOG_DEFAULT_LEVEL_INFO=y

# WiFi
CONFIG_ESP_WIFI_STATIC_RX_BUFFER_NUM=10

# Camera tuning
CONFIG_XTENSA_IMPL_WAR=y
```
